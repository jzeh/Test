/**
  ******************************************************************************
  * @file    GIT_VCI.c
  * @author  GIT Application Team by james jean
  * @version V 1.0
  * @date    26-MAR-2014
  * @brief   Manager GIT_VCI.c module
  ******************************************************************************
 **/


//stm32F1 ?ø??? ?????? ??? ???

/* Includes ------------------------------------------------------------------*/
#include "string.h"
#include "main.h"
#include "GIT_VCI.h"
#include "GIT_Interprotocol.h"
#include "GIT_CanParsingProc.h"
#include "GIT_OemInterface.h"
#include "OBD_Manager.h"
#include "HalHandler.h"
#include "OBD_CGW_Security.h"

extern U8	g_ucDtcSystemCnt;						//slave(dtc) count
extern bool g_bFuelLiterTypeFlag;
extern U8	g_usCurrentCnt;
extern stSlaveData	*g_pstCurrDataBase;
extern unsigned char g_ucFuelLevelMaxLiter;
extern stBrakeJudder g_stBrakeJudder;
#ifdef CGW_SECURITY
extern unsigned char g_unCGWSeed[8];
#endif

/* Defines  ------------------------------------------------------------------*/

//#define DEBUG_GIT_VCI_LOG


/* Global Variables ----------------------------------------------------------*/
stRECORD_HW_SET		g_stGITHWSetData;
stGITSetConfig 		g_stGITSetConfig;
stSBYTE_ARRAY			g_stGITSByteArray;

unsigned long 	g_ulDeviceID;
unsigned long		g_ulProtocolID;
unsigned long		g_ulProtocolFlag;

#if 1 // James Jean 2018/11/14
extern unsigned int g_uiAutoVinReqPacketIdx;
extern eAUTOVIN_STATE g_eAutoVinReqFuelType;
extern eCV_AUTOVIN_STATE g_eCVAutoVinReqFuelType;
extern bool g_bAutoVinNegativeResponse;
#endif

/* Function Define  ----------------------------------------------------------*/
extern unsigned int Get_Odmeter(void);
extern void Set_Wdt(u16 mscnt);

void VCI_Initialize(void)
{
	//DLC_RxBuffClear();

	// Init SConfig list
	memset((void*)&g_stGITSetConfig, 0x00, sizeof(stGITSetConfig));
#if defined(HS_MODIFY)
	memset((void*)&g_stGITSetConfig_2,0x00, sizeof(stGITSetConfig_2));
#endif
	g_stGITSetConfig.nDataRate 		= 10417;
	g_stGITSetConfig.nLoopBack 		= OFF;
	g_stGITSetConfig.nNodeAddress 	= 0;
	g_stGITSetConfig.nNetworkLine 	= 0;
	g_stGITSetConfig.nP1Min 		= 0;
	g_stGITSetConfig.nP1Max 		= 20;
	g_stGITSetConfig.nP2Min 		= 25;
	g_stGITSetConfig.nP2Max 		= 50;
	g_stGITSetConfig.nP3Min 		= 60;
	g_stGITSetConfig.nP3Max 		= 5000;
	g_stGITSetConfig.nP4Min 		= 5;
	g_stGITSetConfig.nP4Max 		= 20;
	//	g_stGITSetConfig.nW0 			= 2;
	g_stGITSetConfig.nW1 			= 1000;
	g_stGITSetConfig.nW2 			= 1000;
	g_stGITSetConfig.nW3 			= 1000;
	g_stGITSetConfig.nW4 			= 30;
	g_stGITSetConfig.nW5 			= 300;
	g_stGITSetConfig.nTIdle 		= 300;
	g_stGITSetConfig.nTInil 		= 25;
	g_stGITSetConfig.nTWUp 			= 50;
	g_stGITSetConfig.nParity 		= 0;
	g_stGITSetConfig.nBitSamplePoint = 80;
	g_stGITSetConfig.nSyncJumpWidth = 15;
	g_stGITSetConfig.nT1Max 		= 20;
	g_stGITSetConfig.nT2Max 		= 100;
	g_stGITSetConfig.nT3Max 		= 50;
	g_stGITSetConfig.nT4Max 		= 20;
	g_stGITSetConfig.nT5Max 		= 100;
	g_stGITSetConfig.nIso15765BS 	= 8;
	g_stGITSetConfig.nIso15765STMin = 2;
	g_stGITSetConfig.nBSTx 			= 0xFFFF;
	g_stGITSetConfig.nSTMinTx 		= 0xFFFF;
	g_stGITSetConfig.nDataBits 		= 0;
	g_stGITSetConfig.nFiveBaudMod 	= 0;
	g_stGITSetConfig.nToolManufacturerSpec = 0;
	g_stGITSetConfig.nEtc1 			= 0;
	g_stGITSetConfig.nEtc2 			= 0;
	g_stGITSetConfig.nEtc3 			= 0;
	g_stGITSetConfig.nEtc4 			= 0;
	g_stGITSetConfig.nEtc5 			= 0;

#if defined(HS_MODIFY)
	//J2534-2 SetConfig List Initial
	g_stGITSetConfig_2.nCanMixedFormat        = 0;
	g_stGITSetConfig_2.nJ1962_Pins            = 0;
	g_stGITSetConfig_2.nSWCanDataRate         = 8333;
	g_stGITSetConfig_2.nSWCanSpeedChange      = 0;
	g_stGITSetConfig_2.nSWCanResSwitch        = 0;
	g_stGITSetConfig_2.nActiveChannel         = 0;         //Hardware dependent
	g_stGITSetConfig_2.nSampleRate            = 0;
	g_stGITSetConfig_2.nSamplePerReading      = 1;
	g_stGITSetConfig_2.nReadingPerMsg         = 1;
	g_stGITSetConfig_2.nAverageMethod         = 0;
	g_stGITSetConfig_2.nSampleResolution      = 0x01;      //Hardware dependent
	g_stGITSetConfig_2.nInputRangeLow         = 0x7FFFFFFF;//Hardware dependent
	g_stGITSetConfig_2.nInputRangeHigh        = 0x7FFFFFFF;//Hardware dependent
	g_stGITSetConfig_2.nUEB_T0_Min            = 0x10;
	g_stGITSetConfig_2.nUEB_T1_Max            = 400;
	g_stGITSetConfig_2.nUEB_T2_Max            = 200;
	g_stGITSetConfig_2.nUEB_T3_Max            = 200;
	g_stGITSetConfig_2.nUEB_T4_Min            = 1;
	g_stGITSetConfig_2.nUEB_T5_Max            = 1000;
	g_stGITSetConfig_2.nUEB_T6_Max            = 200;
	g_stGITSetConfig_2.nUEB_T7_Min            = 1;
	g_stGITSetConfig_2.nUEB_T7_Max            = 40;
	g_stGITSetConfig_2.nUEB_T9_Min            = 1;
	g_stGITSetConfig_2.nJ1939_Pins            = 0;
	g_stGITSetConfig_2.nJ1708_Pins            = 0;
	g_stGITSetConfig_2.nJ1939_T1              = 750;
	g_stGITSetConfig_2.nJ1939_T2              = 1250;
	g_stGITSetConfig_2.nJ1939_T3              = 1250;
	g_stGITSetConfig_2.nJ1939_T4              = 1050;
	g_stGITSetConfig_2.nJ1939_Brdcst_MinDelay = 50;
	g_stGITSetConfig_2.nTP20_T_BR_Int         = 20;
	g_stGITSetConfig_2.nTP20_T_E              = 100;
	g_stGITSetConfig_2.nTP20_MNTC             = 10;
	g_stGITSetConfig_2.nTP20_T_Cta            = 1000;
	g_stGITSetConfig_2.nTP20_MNCT             = 5;
	g_stGITSetConfig_2.nTP20_MNTB             = 5;
	g_stGITSetConfig_2.nTP20_MNT              = 2;
	g_stGITSetConfig_2.nTP20_T_Wait           = 100;
	g_stGITSetConfig_2.nTP20_T1               = 100;
	g_stGITSetConfig_2.nTP20_T3               = 0;
	g_stGITSetConfig_2.nTP20_Identifer        = 0;
	g_stGITSetConfig_2.nTP20_RxIdPassive      = 0;
#endif

	// init SByte Array
	memset((void*)&g_stGITSByteArray, 0x00, sizeof(g_stGITSByteArray));

#if defined(FEATURE_GDS_VCI_AM)
	usbTxFlag = USB_BUFF_EMPTY;
	IsContWriteMsg = FALSE;
	Ackflag = 0;
	J2534PassThruRxMsgNum = 0;
	J2534PassThruRxTempMsgNum = 0;
	J2534PassThruContRxMsgNum = 0;
	DlcRxBlock = 0;
	DlcTxBlock = 0;
	IsResetWriteMsgs = FALSE;
	J2534AckModeStatus = 1;

	g_stGITSByteArray.BytePtr = g_arrSByteArray;
#endif

	// init HWSetting Data
	memset((void*)&g_stGITHWSetData, 0x00, sizeof(g_stGITHWSetData));
#if 1
	g_stGITHWSetData.nCommRelay 	= KLLINE_RELAY;
	g_stGITHWSetData.nKlineSelect 	= K_SERIAL;
	g_stGITHWSetData.nKlineStatus 	= K_NORMAL;
	g_stGITHWSetData.nLlineSelect 	= L_PULSE;
	g_stGITHWSetData.nLlineStatus 	= L_NORMAL;
	g_stGITHWSetData.nKlineSwitchStatus = K_PULSE_LOW;
	g_stGITHWSetData.nLlineSwitchStatus = L_PULSE_HIGH;
	g_stGITHWSetData.nRxLineSelect 	= RXD_OBD2;
	g_stGITHWSetData.nRxLineStatus 	= RXD_NORMAL;
	g_stGITHWSetData.nPullupRelay 	= Pullup;
	g_stGITHWSetData.nKlinePullup 	= K_Pullup_510;
	g_stGITHWSetData.nLlinePullup 	= L_Pullup_510;
	g_stGITHWSetData.nLlineGnd 		= 0;
	g_stGITHWSetData.nKlineCh 		= K_Ch04;
	g_stGITHWSetData.nLlineCh 		= L_ChOff;
	g_stGITHWSetData.nRProgramCh 	= R_ChOff;
	//	g_stGITHWSetData.nEtc1 			=
	//	g_stGITHWSetData.nEtc2 			=
	//	g_stGITHWSetData.nEtc3 			=
	//	g_stGITHWSetData.nEtc4 			=
	//	g_stGITHWSetData.nEtc5 			=
	//	g_stGITHWSetData.ackmessage[20] =
#else
	g_stGITHWSetData.nKlineCh = KCh07;
#endif
}

void VCI_REINTI_COMM_STATE(unsigned long ulPID)
{
	CAN_InitVariable();
//	CAN_Reinit(g_stGitCommInfo[eCOMM_TYPE_CAN1].pstInQueue);
//	CAN_Reinit(g_stGitCommInfo[eCOMM_TYPE_CAN2].pstInQueue);
}

void VCI_DLC_HW_Set(U8 CommRelay,U8 KlineSelect,U8 KlineStatus,U8 RxLineStatus,U8 KlinePullup,U8 KlineChSet)
{

}

void VCI_HWSetParameter(unsigned char* pData)
{

}

void VCI_GetRtcTime(unsigned char *pSetDate)
{
	//OemGetRTCTime(pSetDate);
}

//void VCI_HW_Setting(unsigned long uiPID)
//{
//	u32 nStartMask;
//	u32 nEndMask;
//	u32 nCanChannel, nCanType, nCANBaudrate;
//
//	g_ulProtocolID = uiPID;
//	VCI_REINTI_COMM_STATE(uiPID);
//
//	if ( uiPID == ISO15765_CARB_29BIT )
//		nCanType = EXTENDED_CAN;
//	else
//		nCanType = STANDARD_CAN;
//
//	if ( g_ucCAN_CH == LOW_CAN_CH )
//		nCanChannel = CAN_CHANNEL_2;
//	else
//		nCanChannel = CAN_CHANNEL_1;
//
//	if ( nCanType == EXTENDED_CAN )
//	{
//		nStartMask = 0x800;
//		nEndMask = 0x1FFFFFFF;
//	}
//	else
//	{
//		nStartMask = 0x0700; // set Default Masking value
//		nEndMask = 0x07FF;
//	}
//
//	// CAN ID에 대한 예외처리 추가
//	if ( nStartMask > nEndMask )
//	{
//		u32 nTmp = nStartMask;
//
//		nStartMask = nEndMask;
//		nEndMask = nTmp;
//	}
//
//	if( (uiPID == ISO15765_CAN_HWSET_DB ) || (uiPID == ISO15765_CAN_HWSET_DB_SINGLE))
//	{
//		nCANBaudrate = g_stGITSetConfig.nDataRate;
//		//g_stGITHWSetData.nCommRelay = Lowcan1;//init CHJ LOW_CAN 통신이니깐.. Lowcan1이어야 LO CH2로 set
//	}
//	else
//	{
//		nCANBaudrate = eCAN_500KBPS;
//		g_stGITHWSetData.nCommRelay = Highcan1;
//	}
//
//	Oem_CAN_Channel_Initialize(nCanChannel, g_stGITHWSetData.nCommRelay, nCANBaudrate);
//	Oem_CAN_Channel_Masket_Set(nCanChannel, nCanType, 1, &nStartMask, &nEndMask);
//
//#if defined(DEBUG_GIT_VCI_LOG)
//	GITDebugPrintf("[%s] CANBaudrate %d, CanType %d, CanChannel %d, StartMask 0x%X, EndMask 0x%X, CommRelay %d\r\n",
//	__FUNCTION__, nCANBaudrate, nCanType, nCanChannel, nStartMask, nEndMask, g_stGITHWSetData.nCommRelay);
//#endif
//}

void VCI_SetPassThruDeviceID(unsigned char *pData)
{
	memcpy(&g_ulDeviceID, pData, sizeof(g_ulDeviceID));
}

unsigned long VCI_GetPassThruDeviceID(void)
{
	return g_ulDeviceID;
}

void VCI_SetPassThruProtocolID(unsigned char *pData)
{
	memcpy((char *)&g_ulProtocolID, pData, sizeof(g_ulProtocolID));
}

unsigned long VCI_GetPassThruProtocolID(void)
{
#if defined(DEBUG_GIT_VCI_LOG)
//	GITDebugPrintf("[%s] protocol ID 0x%0X\r\n", __FUNCTION__, g_ulProtocolID);
#endif
	return g_ulProtocolID;
}

void VCI_SetPassThruConnectFlags(unsigned char *pData)
{
	memcpy((char *)&g_ulProtocolFlag, pData, sizeof(g_ulProtocolFlag));
}

unsigned long VCI_GetPassThruConnectFlags(void)
{
	return g_ulProtocolFlag;
}

void VCI_SetPassThruBaudrate(unsigned char *pData)
{
	memcpy(&g_stGITSetConfig.nDataRate, pData, sizeof(g_stGITSetConfig.nDataRate));

#if defined(DEBUG_GIT_VCI_LOG)
	GITDebugPrintf("[%s] g_stGITSetConfig.nDataRate %d\r\n", __FUNCTION__, g_stGITSetConfig.nDataRate);
#endif
}

unsigned long VCI_GetPassThruBaudrate(void)
{
	return g_stGITSetConfig.nDataRate;
}

void VCI_SetPassThruWirteMsgTimeout(unsigned char *pData, unsigned int uiDataLen)
{
	unsigned long ulTimeout;
	memcpy(&ulTimeout, pData, uiDataLen); // VCI 는 아직 참조할 필요 없음.
}

bool VCI_FunctionClassification(U8 FunctionType,  U8 ParaCounter)
{
	//eFUNCTION_COMM_STATE eState;
	unsigned long uiProtocolID;
	stPASSTHRU_MSG stData;
	unsigned int uiDataLen=10;
	char str[10];
	int size;
	int i=0,j=0;
	U8 ucNowTime[8] = {0,};
	unsigned char ucVehicleCANCheckSize = 0;
	uint8_t ucPACVType=0;
    GetAutolinkConfigProperty(eAutoLinkConfig_PACVType,(void*)&ucPACVType);

	BYTE VINcode[eAUTOVIN_REQ_MAX][10] = {
							   {0x07, 0xE2, 0x03, 0x22, 0xF1, 0x90, 0x00, 0x00, 0x00, 0x00},       // AutoVin Reqeust Packet, eAUTOVIN_ELECTIC_UDS_REQ
							   {0x07, 0xDF, 0x02, 0x09, 0x02, 0x00, 0x00, 0x00, 0x00, 0x00},       // AutoVin Reqeust Packet, eAUTOVIN_ENGINE_REQ
                               {0x07, 0xE2, 0x02, 0x1A, 0x90, 0x00, 0x00, 0x00, 0x00, 0x00},       // AutoVin Reqeust Packet, eAUTOVIN_ELECTIC_REQ
//                             {0x07, 0xD6, 0x02, 0x1A, 0x90, 0x00, 0x00, 0x00, 0x00, 0x00},       // AutoVin Reqeust Packet
						       {0x07, 0x64, 0x03, 0x22, 0xf1, 0x90, 0x00, 0x00, 0x00, 0x00},       // FCEV AutoVin Reqeust Packet, eAUTOVIN_HYDRO_REQ
    };

 	BYTE CVVINcode[eAUTOVIN_CV_REQ_MAX][10] = {
							   {0x18, 0xDA, 0x00, 0xF9, 0x04, 0x21, 0x41, 0x01, 0x01, 0x00},       // CV : Unviverse(PY), eAUTOVIN_CV_UNIVERSE_REQ
							   {0x18, 0xDA, 0xEF, 0xF9, 0x03, 0x22, 0xF1, 0x90, 0x00, 0x00},       // CV : Elec City(LK), eAUTOVIN_CV_ELECCITY_REQ
 	};

	BYTE VINcodeNegative[10] = {0x07, 0xDF, 0x02, 0x09, 0x00, 0x00, 0x00, 0x00, 0x00, 0x00};		// 인도 IB 디젤에서 부정 응답 수신시 전달해줘야하는 패킷, 전달 후 수신 받는 패킷{0x07, 0xE8, 0x06, 0x49, 0x00, 0x54, 0x20, 0x00, 0x00, 0xFF}	// 이거 안탄다. GitCANReadMsgs()에서 0x7f이면 바로 return 

	BYTE UDSOpencode[10] = {0x07, 0xE0, 0x02, 0x10, 0x01, 0x00, 0x00, 0x00, 0x00, 0x00};
	BYTE FuelLevelCheckCode[10] = {0x07, 0xC6, 0x03, 0x22, 0xB0, 0x02, 0x00, 0x00, 0x00, 0x00};	//07C60322B002
	BYTE CARBOpencode[10] = {0x07, 0xDF, 0x02, 0x01, 0x01, 0x00, 0x00, 0x00, 0x00, 0x00};
#ifdef CGW_SECURITY
    BYTE ucSeed[8]={0,};
	BYTE UDSCARBOpenCode[10] = {0x07, 0xDF, 0x02, 0x10, 0x01, 0x00, 0x00, 0x00, 0x00, 0x00};
	BYTE CGWUDSExtOpencode[10] = {0x07, 0x70, 0x02, 0x10, 0x03, 0x00, 0x00, 0x00, 0x00, 0x00};
	//1set
	/*BYTE CGWCertificate[] = {0x07,0x70,0x5A,0x27,0x41,
							0x01, 0x48, 0x4D, 0x43, 0x03, 0x43, 0x41, 0x01, 0x00, 0x00, 0x00, 0x00, 0x00, 0x00, 0x01, 0x21, 0x05, 0x25, 0x22, 0x06, 
							0x19, 0x00, 0x01, 0x00, 0x02, 0x04, 0x10, 0x00, 0x20, 0x01, 0x00, 0x00, 0x01, 0x00, 0x01, 0x00, 0x03, 0x00, 0x00, 0x00, 
							0x00, 0x00, 0x00, 0x00, 0x48, 0x4D, 0x43, 0x08, 0x47, 0x48, 0x4D, 0x41, 0x55, 0x50, 0x53, 0x30, 0x00, 0x04, 0x12, 0x61, 
							0x00, 0x60, 0x00, 0x07, 0x00, 0x01, 0x00, 0x02, 0x08, 0x40, 0x00, 0x11, 0x35, 0x49, 0x00, 0x01, 0x00, 0x01, 0x00, 0x01, 
							0x00, 0x00, 0x00, 0x00, 0x00, 0x01, 0x00, 0x01, 0xB1, 0xC5, 0x6D, 0xAD, 0xC9, 0x7F, 0x2E, 0x24, 0xB0, 0x2F, 0xD2, 0xA0, 
							0x6B, 0xE5, 0x88, 0xD9, 0x4B, 0x25, 0xF1, 0x07, 0xDB, 0xCB, 0x4C, 0x17, 0x79, 0xAF, 0x7D, 0xA0, 0xD1, 0x24, 0x41, 0x56, 
							0x62, 0xF7, 0xF7, 0x87, 0x48, 0x0B, 0xB2, 0xA5, 0x61, 0x52, 0x93, 0x06, 0x9D, 0x06, 0x99, 0x17, 0x73, 0x95, 0xDE, 0xCB, 
							0xDA, 0x3E, 0x3A, 0x64, 0x40, 0x4D, 0x2C, 0xE3, 0xE7, 0x7D, 0x7B, 0xB2, 0xB4, 0x4D, 0xB8, 0x12, 0x1A, 0xBD, 0xDE, 0xB3, 
							0x9C, 0xB1, 0x24, 0x7F, 0xA8, 0xEB, 0xC3, 0xFA, 0x7A, 0xF0, 0x93, 0x67, 0x2F, 0x17, 0x30, 0x7F, 0x45, 0x74, 0x6D, 0x4D, 
							0xCD, 0xCA, 0xD8, 0x04, 0x89, 0x50, 0x25, 0x43, 0x09, 0x49, 0xF2, 0xA3, 0xCA, 0x7D, 0x6E, 0xEE, 0x12, 0xB7, 0x97, 0x2E, 
							0x50, 0x3E, 0xC8, 0xA1, 0x8D, 0x57, 0x4E, 0x6B, 0x26, 0x18, 0x15, 0x48, 0x3C, 0x65, 0x7E, 0x4D, 0x6B, 0x21, 0x74, 0x5D, 
							0x8A, 0x66, 0xC5, 0x10, 0xCB, 0x84, 0x49, 0xB7, 0xFF, 0x1C, 0xD2, 0x9A, 0x90, 0x20, 0xD8, 0x73, 0x61, 0xEF, 0x83, 0xCA, 
							0x4D, 0x91, 0x1A, 0x1E, 0xA5, 0xF3, 0x63, 0xE8, 0x08, 0xD4, 0xF7, 0x43, 0xBE, 0x6B, 0x38, 0x5A, 0x16, 0x46, 0xF2, 0x96, 
							0x19, 0xE8, 0x47, 0x3D, 0xA9, 0x2B, 0x17, 0x70, 0x56, 0xB1, 0x25, 0x43, 0x78, 0x2F, 0x20, 0xB0, 0x03, 0x2D, 0x32, 0x7F, 
							0x1B, 0x90, 0xD6, 0x66, 0xC3, 0xD5, 0xFF, 0x10, 0x77, 0xC9, 0x1B, 0x93, 0x5B, 0x2F, 0x33, 0x67, 0xDC, 0x38, 0x5E, 0xE3, 
							0x23, 0x0A, 0xF9, 0x77, 0x47, 0x52, 0x79, 0xE3, 0xBA, 0x84, 0x98, 0xA2, 0x7C, 0x6C, 0xC2, 0xB8, 0xE0, 0xDE, 0xDA, 0x4F, 
							0xC0, 0xF8, 0x25, 0xAB, 0x26, 0xCC, 0x75, 0xE7, 0x78, 0xC0, 0xB2, 0x22, 0xA8, 0x64, 0xE7, 0x03, 0x03, 0x11, 0x8B, 0x85, 
							0x06, 0x73, 0x9B, 0xFB, 0x1F, 0xFF, 0x8B, 0x15, 0xE7, 0xAE, 0x7D, 0xA5, 0x15, 0x03, 0x74, 0x4A, 0x70, 0xC6, 0xAD, 0x88, 
							0xE5, 0x62, 0x26, 0x7F, 0xA7, 0xDA, 0xA4, 0xC2, 0x04, 0x71, 0x3E, 0x32, 0xD1, 0x28, 0xBE, 0x2F, 0x03, 0x24, 0xAA, 0x04, 
							0xF4, 0xB8, 0x83, 0xFB, 0xA2, 0x5E, 0xE5, 0xFA, 0x14, 0xE7, 0x92, 0xE2, 0x55, 0xE1, 0xF0, 0x20, 0x87, 0x3A, 0xB1, 0x16, 
							0xE6, 0x1B, 0x66, 0x74, 0xF0, 0x5C, 0x9F, 0x73, 0x75, 0x95, 0xA6, 0x9F, 0xBA, 0x53, 0x1C, 0x75, 0x56, 0xD2, 0xF6, 0xCE, 
							0x76, 0x8B, 0x95, 0x73, 0x0D, 0x2A, 0xD0, 0x88, 0x70, 0x67, 0xF9, 0xE5, 0xEA, 0x03, 0x8C, 0x19, 0x88, 0x71, 0x09, 0xFA, 
							0x5E, 0xD2, 0x5A, 0x67, 0x41, 0x45, 0xAA, 0xE2, 0xBA, 0x0D, 0x97, 0x48, 0x47, 0xB9, 0xCD, 0x4D, 0x40, 0xD6, 0x8E, 0xAA, 
							0x65, 0xFE, 0x21, 0x04, 0x25, 0x51, 0xBA, 0x28, 0x22, 0xC3, 0x47, 0xBC, 0xB9, 0xEB, 0x5A, 0x0B, 0x12, 0x0C, 0x38, 0x38, 
							0x32, 0x3A, 0xA9, 0x94, 0x48, 0x38, 0x7E, 0xE2, 0x79, 0xD1, 0x52, 0xFC, 0x4C, 0xD8, 0x8C, 0x22, 0xE1, 0x8E, 0x3F, 0xD5, 
							0x34, 0x43, 0x27, 0xEB, 0xA8, 0x96, 0xFC, 0x4B, 0x12, 0x38, 0x47, 0x34, 0x7D, 0xD9, 0xCC, 0x5F, 0x34, 0x01, 0xBA, 0xD2, 
							0x8F, 0x73, 0x6B, 0xEF, 0x9C, 0x8F, 0xC0, 0x05, 0x36, 0xC4, 0xA9, 0x8C, 0x0E, 0x9A, 0x24, 0x53, 0x6F, 0x84, 0x7A, 0xBA, 
							0x00, 0x44, 0x92, 0x66, 0xE9, 0xCB, 0x33, 0x09, 0xBE, 0x45, 0x25, 0x5E, 0x13, 0x3C, 0xAA, 0x4F, 0x40, 0x04, 0x13, 0x7D, 
							0x76, 0x35, 0x90, 0xC4, 0x6A, 0xAE, 0x76, 0x11, 0x11, 0xD8, 0xDD, 0xFC, 0xA3, 0xFE, 0xDA, 0x47, 0xBE, 0x8C, 0x83, 0x8D, 
							0xB8, 0xBC, 0xDD, 0x10, 0x12, 0x4F, 0x2F, 0x00, 0x21, 0xA3, 0xD1, 0x55, 0x10, 0xD8, 0xFF, 0x59, 0xD7, 0xE7, 0x94, 0xB4};*/
	BYTE CGWCertificate2[256+5]={0,};
	//2set
	/*BYTE CGWCertificate[] = {0x07,0x70,0x5A,0x27,0x41,
							0x01,0x48,0x4d,0x43,0x03,0x43,0x41,0x01,0x00,0x00,0x00,0x00,0x00,0x00,0x01,0x22,0x03,0x31,0x23,0x04,0x13,0x00,0x01,0x00,
							0x02,0x04,0x10,0x00,0x20,0x01,0x00,0x00,0x01,0x00,0x01,0x00,0x03,0x00,0x00,0x00,0x00,0x00,0x00,0x00,0x48,0x4d,0x43,0x08,
							0x47,0x49,0x54,0x30,0x55,0x50,0x53,0x30,0x00,0x04,0x64,0x09,0x00,0x60,0x00,0x07,0x00,0x01,0x00,0x02,0x08,0x40,0x00,0x11,
							0x35,0x49,0x00,0x01,0x00,0x01,0x00,0x01,0x00,0x00,0x00,0x00,0x00,0x01,0x00,0x01,0x89,0x8b,0xcb,0x63,0x95,0x4a,0xa2,0x19,
							0x38,0x8c,0x23,0x4d,0x0b,0xbd,0x34,0xc0,0x2b,0xff,0x34,0xee,0xe2,0xdd,0xe8,0xfa,0x01,0x04,0xf5,0x5f,0xdc,0x22,0x20,0xfb,
							0x5e,0xac,0x81,0x4c,0x4c,0x0c,0x93,0xc2,0xe3,0xa3,0xfb,0x3b,0xfb,0xf1,0xc0,0x99,0x78,0xcc,0xd1,0x7f,0x00,0x3b,0xf6,0x4e,
							0x94,0x7c,0x83,0x30,0xe9,0x40,0xc0,0x2c,0x2d,0x11,0xdd,0x8d,0x37,0xfd,0xb5,0x90,0x8d,0xcb,0xb2,0xe4,0xa9,0x72,0x46,0x64,
							0xc2,0xc3,0xc0,0x9f,0xda,0x3a,0xe6,0xcb,0xf8,0x75,0xe3,0x13,0x7f,0xe0,0xbc,0xe7,0xe0,0x1a,0x4f,0x0d,0x8b,0x44,0x7f,0xfb,
							0x2c,0x83,0x15,0xda,0x29,0x5c,0xb2,0x8f,0x06,0xbc,0x2a,0x71,0x05,0x49,0x40,0x7d,0x51,0x9e,0xbf,0x94,0xdf,0xc9,0x36,0xf3,
							0x2d,0x3e,0x85,0x66,0xcb,0x99,0x58,0x9d,0xc5,0x57,0x95,0x71,0x50,0x07,0x5a,0x35,0xf0,0xb1,0x6c,0x53,0xe4,0x83,0x11,0xcd,
							0x4a,0x70,0x08,0xb8,0x32,0x36,0xf0,0x09,0x8b,0xfb,0x00,0xdf,0x61,0x63,0x44,0x62,0xda,0xb6,0xb2,0x4a,0xaf,0xcc,0x6d,0x5f,
							0xa0,0xee,0x62,0xb9,0x59,0x9c,0x7b,0x62,0x4f,0xe1,0xd1,0x81,0x39,0x96,0x67,0x10,0xc0,0x89,0xe6,0xc3,0x13,0xc4,0x0e,0x80,
							0x68,0xe0,0x0d,0x88,0x3a,0x56,0xf2,0x82,0x25,0xb0,0xa7,0xf5,0xd4,0xa2,0x2d,0xf0,0xbb,0x2c,0x7a,0x7b,0x20,0xce,0xd9,0x92,
							0x06,0x69,0xae,0xfe,0xe1,0xb5,0x01,0x76,0x2e,0x9f,0xb9,0x3b,0x22,0xf3,0x47,0xef,0xa9,0xf3,0xe3,0x23,0x11,0x18,0x77,0xfa,
							0x57,0xb3,0xba,0x73,0x47,0x7c,0x4e,0xa3,0x5c,0x98,0xbd,0x15,0x65,0x13,0xea,0xf4,0xfb,0x7a,0xff,0xfb,0x05,0x85,0xdc,0x1b,
							0x6f,0xcc,0xfa,0x04,0xba,0x80,0x84,0x5a,0xc1,0xa7,0x87,0x20,0x1d,0x90,0x6f,0x30,0x43,0x3f,0x7f,0x47,0x5d,0xa7,0x6d,0x69,
							0xa9,0xf1,0x15,0x25,0x1c,0x74,0xa4,0x4c,0x36,0x0b,0xa6,0x11,0x48,0xe4,0x61,0xc3,0x1d,0x31,0xd8,0xd2,0x39,0x75,0xc9,0x3b,
							0x2b,0x5a,0x8b,0xf7,0x19,0x1a,0x8f,0x77,0xe8,0x1e,0xbf,0x03,0x93,0x07,0xf1,0x3e,0xe1,0x02,0x8b,0x2d,0xd5,0xb7,0x84,0x9b,
							0x9b,0x73,0x93,0x4e,0xee,0x4d,0x92,0x3e,0x3c,0xfe,0xf1,0xd0,0x8b,0x9c,0x8f,0x3d,0x3d,0x6d,0x17,0x05,0x14,0x3d,0x3e,0x58,
							0xc6,0x08,0xfb,0xd7,0xb5,0x42,0xf8,0x51,0x07,0x46,0x0b,0x97,0xcd,0x8b,0x18,0xa6,0x9f,0xd7,0xc5,0x3d,0xbf,0x40,0x74,0xa4,
							0xcd,0xfa,0x10,0xcf,0xcd,0x83,0x60,0x07,0x96,0x21,0x1b,0x81,0x57,0xe0,0x5c,0x2f,0x16,0xab,0x92,0x69,0xb6,0x0b,0xd5,0xc9,
							0x94,0xa2,0xb0,0x60,0x8f,0xd8,0x0f,0xa4,0xea,0xce,0x0f,0xd4,0x29,0x76,0x97,0xc6,0xd0,0x6c,0x27,0x18,0x94,0xa6,0x0e,0x67,
							0x2d,0x58,0x90,0x4c,0x2a,0x04,0xd8,0xf1,0x4f,0x2d,0x92,0xc8,0x8b,0x87,0x5c,0x5d,0x29,0xe8,0x98,0xa5,0x09,0xaa,0x14,0x11,
							0xe4,0xd1,0x91,0x12,0x1f,0x56,0xbc,0x9f,0xa1,0xf3,0x85,0x3a,0x83,0x8b,0xbb,0x9f,0x9c,0x13,0x6f,0x1b,0x63,0x30,0xbc,0xd8,
							0xa4,0x67,0xe6,0x0c,0x35,0x73,0x5f,0x4b,0x78,0x24,0x80,0xd3,0x1f,0xf2,0xed,0x7d,0x22,0xc7,0x4f,0x02,0x31,0x17,0xdb,0x23};*/
#if 1  //jkc 변경 24/03/17
    //2-2set
    BYTE CGWCertificate[] = {0x07,0x70,0x5A,0x27,0x41,
                            0x01,0x48,0x4d,0x43,0x03,0x43,0x41,0x01,0x00,0x00,0x00,0x00,0x00,0x00,0x01,0x23,0x03,0x15,0x24,0x03,0x17,0x00,0x01,0x00,
                            0x02,0x04,0x10,0x00,0x20,0x01,0x00,0x00,0x01,0x00,0x01,0x00,0x03,0x00,0x00,0x00,0x00,0x00,0x00,0x00,0x48,0x4d,0x43,0x08,
                            0x47,0x49,0x54,0x30,0x55,0x50,0x53,0x30,0x00,0x05,0x48,0x36,0x00,0x60,0x00,0x07,0x00,0x01,0x00,0x02,0x08,0x40,0x00,0x11,
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                            0x8b,0xb1,0x81,0x66,0xc4,0x2c,0xd0,0xca,0xb3,0xd3,0x98,0x33,0x15,0xb9,0x12,0x5f,0x6c,0xdf,0xad,0xb0,0x96,0xef,0xc0,0xf5};
#else  //  기존 			
    //2-2set
    BYTE CGWCertificate[] = {0x07,0x70,0x5A,0x27,0x41,
                            0x01,0x48,0x4D,0x43,0x03,0x43,0x41,0x01,0x00,0x00,0x00,0x00,0x00,0x00,0x01,0x22,0x03,0x31,0x23,0x04,0x13,0x00,0x01,0x00,
                            0x02,0x04,0x10,0x00,0x20,0x01,0x00,0x00,0x01,0x00,0x01,0x00,0x03,0x00,0x00,0x00,0x00,0x00,0x00,0x00,0x48,0x4D,0x43,0x08,
                            0x47,0x49,0x54,0x30,0x55,0x50,0x53,0x30,0x00,0x04,0x64,0x09,0x00,0x60,0x00,0x07,0x00,0x01,0x00,0x02,0x08,0x40,0x00,0x11,
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                            0xA4,0x67,0xE6,0x0C,0x35,0x73,0x5F,0x4B,0x78,0x24,0x80,0xD3,0x1F,0xF2,0xED,0x7D,0x22,0xC7,0x4F,0x02,0x31,0x17,0xDB,0x23};
#endif
	//3set
	/*BYTE CGWCertificate[] = {0x07,0x70,0x5A,0x27,0x41,
							0x01,0x48,0x4D,0x43,0x03,0x43,0x41,0x01,0x00,0x00,0x00,0x00,0x00,0x00,0x01,0x21,0x05,0x25,0x22,0x06,
							0x19,0x00,0x01,0x00,0x02,0x04,0x10,0x00,0x20,0x01,0x00,0x00,0x01,0x00,0x01,0x00,0x03,0x00,0x00,0x00,
							0x00,0x00,0x00,0x00,0x48,0x4D,0x43,0x08,0x47,0x48,0x4D,0x41,0x55,0x50,0x53,0x30,0x00,0x04,0x12,0x61,
							0x00,0x60,0x00,0x07,0x00,0x01,0x00,0x02,0x08,0x40,0x00,0x11,0x35,0x49,0x00,0x01,0x00,0x01,0x00,0x01,
							0x00,0x00,0x00,0x00,0x00,0x01,0x00,0x01,0xB1,0xC5,0x6D,0xAD,0xC9,0x7F,0x2E,0x24,0xB0,0x2F,0xD2,0xA0,
							0x6B,0xE5,0x88,0xD9,0x4B,0x25,0xF1,0x07,0xDB,0xCB,0x4C,0x17,0x79,0xAF,0x7D,0xA0,0xD1,0x24,0x41,0x56,
							0x62,0xF7,0xF7,0x87,0x48,0x0B,0xB2,0xA5,0x61,0x52,0x93,0x06,0x9D,0x06,0x99,0x17,0x73,0x95,0xDE,0xCB,
							0xDA,0x3E,0x3A,0x64,0x40,0x4D,0x2C,0xE3,0xE7,0x7D,0x7B,0xB2,0xB4,0x4D,0xB8,0x12,0x1A,0xBD,0xDE,0xB3,
							0x9C,0xB1,0x24,0x7F,0xA8,0xEB,0xC3,0xFA,0x7A,0xF0,0x93,0x67,0x2F,0x17,0x30,0x7F,0x45,0x74,0x6D,0x4D,
							0xCD,0xCA,0xD8,0x04,0x89,0x50,0x25,0x43,0x09,0x49,0xF2,0xA3,0xCA,0x7D,0x6E,0xEE,0x12,0xB7,0x97,0x2E,
							0x50,0x3E,0xC8,0xA1,0x8D,0x57,0x4E,0x6B,0x26,0x18,0x15,0x48,0x3C,0x65,0x7E,0x4D,0x6B,0x21,0x74,0x5D,
							0x8A,0x66,0xC5,0x10,0xCB,0x84,0x49,0xB7,0xFF,0x1C,0xD2,0x9A,0x90,0x20,0xD8,0x73,0x61,0xEF,0x83,0xCA,
							0x4D,0x91,0x1A,0x1E,0xA5,0xF3,0x63,0xE8,0x08,0xD4,0xF7,0x43,0xBE,0x6B,0x38,0x5A,0x16,0x46,0xF2,0x96,
							0x19,0xE8,0x47,0x3D,0xA9,0x2B,0x17,0x70,0x56,0xB1,0x25,0x43,0x78,0x2F,0x20,0xB0,0x03,0x2D,0x32,0x7F,
							0x1B,0x90,0xD6,0x66,0xC3,0xD5,0xFF,0x10,0x77,0xC9,0x1B,0x93,0x5B,0x2F,0x33,0x67,0xDC,0x38,0x5E,0xE3,
							0x23,0x0A,0xF9,0x77,0x47,0x52,0x79,0xE3,0xBA,0x84,0x98,0xA2,0x7C,0x6C,0xC2,0xB8,0xE0,0xDE,0xDA,0x4F,
							0xC0,0xF8,0x25,0xAB,0x26,0xCC,0x75,0xE7,0x78,0xC0,0xB2,0x22,0xA8,0x64,0xE7,0x03,0x03,0x11,0x8B,0x85,
							0x06,0x73,0x9B,0xFB,0x1F,0xFF,0x8B,0x15,0xE7,0xAE,0x7D,0xA5,0x15,0x03,0x74,0x4A,0x70,0xC6,0xAD,0x88,
							0xE5,0x62,0x26,0x7F,0xA7,0xDA,0xA4,0xC2,0x04,0x71,0x3E,0x32,0xD1,0x28,0xBE,0x2F,0x03,0x24,0xAA,0x04,
							0xF4,0xB8,0x83,0xFB,0xA2,0x5E,0xE5,0xFA,0x14,0xE7,0x92,0xE2,0x55,0xE1,0xF0,0x20,0x87,0x3A,0xB1,0x16,
							0xE6,0x1B,0x66,0x74,0xF0,0x5C,0x9F,0x73,0x75,0x95,0xA6,0x9F,0xBA,0x53,0x1C,0x75,0x56,0xD2,0xF6,0xCE,
							0x76,0x8B,0x95,0x73,0x0D,0x2A,0xD0,0x88,0x70,0x67,0xF9,0xE5,0xEA,0x03,0x8C,0x19,0x88,0x71,0x09,0xFA,
							0x5E,0xD2,0x5A,0x67,0x41,0x45,0xAA,0xE2,0xBA,0x0D,0x97,0x48,0x47,0xB9,0xCD,0x4D,0x40,0xD6,0x8E,0xAA,
							0x65,0xFE,0x21,0x04,0x25,0x51,0xBA,0x28,0x22,0xC3,0x47,0xBC,0xB9,0xEB,0x5A,0x0B,0x12,0x0C,0x38,0x38,
							0x32,0x3A,0xA9,0x94,0x48,0x38,0x7E,0xE2,0x79,0xD1,0x52,0xFC,0x4C,0xD8,0x8C,0x22,0xE1,0x8E,0x3F,0xD5,
							0x34,0x43,0x27,0xEB,0xA8,0x96,0xFC,0x4B,0x12,0x38,0x47,0x34,0x7D,0xD9,0xCC,0x5F,0x34,0x01,0xBA,0xD2,
							0x8F,0x73,0x6B,0xEF,0x9C,0x8F,0xC0,0x05,0x36,0xC4,0xA9,0x8C,0x0E,0x9A,0x24,0x53,0x6F,0x84,0x7A,0xBA,
							0x00,0x44,0x92,0x66,0xE9,0xCB,0x33,0x09,0xBE,0x45,0x25,0x5E,0x13,0x3C,0xAA,0x4F,0x40,0x04,0x13,0x7D,
							0x76,0x35,0x90,0xC4,0x6A,0xAE,0x76,0x11,0x11,0xD8,0xDD,0xFC,0xA3,0xFE,0xDA,0x47,0xBE,0x8C,0x83,0x8D,
							0xB8,0xBC,0xDD,0x10,0x12,0x4F,0x2F,0x00,0x21,0xA3,0xD1,0x55,0x10,0xD8,0xFF,0x59,0xD7,0xE7,0x94,0xB4};*/
#endif
//	g_bCARBReceiving = FALSE;

	uiProtocolID = VCI_GetPassThruProtocolID();

	// compile 시, warning 제거를 위해서
	uiProtocolID = uiProtocolID;

	g_bCARBReceiving = FALSE;
	//eState = FUNCTION_GET_STATE();

	VCI_SetPassThruProtocolID((unsigned char*)&uiProtocolID);
	
	if(ucPACVType == CV)	 	ucVehicleCANCheckSize = 5;
	else            			ucVehicleCANCheckSize = 3; //if(ucPACVType == PA)
	
	switch(FunctionType)
	{
	case eCOMM_UDS_OPEN:
		uiProtocolID = ISO15765;
		VCI_SetPassThruProtocolID((unsigned char*)&uiProtocolID);
		uiDataLen = 10 + 24;	//24 : stPASSTHRU_MSG 의 앞부분
		stData.DataSize = uiDataLen-24;
		memcpy(stData.pData,&UDSOpencode,stData.DataSize);
		break;
#ifdef CGW_SECURITY
	case eCOMM_UDS_CARBOPEN:
		uiProtocolID = ISO15765_CARB;
		VCI_SetPassThruProtocolID((unsigned char*)&uiProtocolID);
		uiDataLen = 10 + 24;	//24 : stPASSTHRU_MSG 의 앞부분
		stData.DataSize = uiDataLen-24;
		memcpy(stData.pData,&UDSCARBOpenCode,stData.DataSize);
		break;
		case eCOMM_UDS_EXTOPEN:
			uiProtocolID = ISO15765;
			VCI_SetPassThruProtocolID((unsigned char*)&uiProtocolID);
		uiDataLen = 10 + 24;	//24 : stPASSTHRU_MSG 의 앞부분
			stData.DataSize = uiDataLen-24;
			memcpy(stData.pData,&CGWUDSExtOpencode,stData.DataSize);
			break;
		case eCOMM_CGW_SECURITY1:
			uiProtocolID = ISO15765;
			VCI_SetPassThruProtocolID((unsigned char*)&uiProtocolID);
		uiDataLen = sizeof(CGWCertificate) + 24;	//24 : stPASSTHRU_MSG 의 앞부분
			stData.DataSize = uiDataLen-24;
			memcpy(stData.pData,&CGWCertificate,stData.DataSize);
			break;
		case eCOMM_CGW_SECURITY2:
			uiProtocolID = ISO15765;
		memset(CGWCertificate2,0,sizeof(CGWCertificate2));
		CGWCertificate2[0]=0x07;
		CGWCertificate2[1]=0x70;
		CGWCertificate2[2]=0x5A;
		CGWCertificate2[3]=0x27;
		CGWCertificate2[4]=0x42;
        memcpy(ucSeed,g_unCGWSeed,sizeof(ucSeed));
		if(!(CGW_Security_Algorithm(ucSeed,&CGWCertificate2[5])))	return false;
			VCI_SetPassThruProtocolID((unsigned char*)&uiProtocolID);
		uiDataLen = sizeof(CGWCertificate2) + 24;	//24 : stPASSTHRU_MSG 의 앞부분
			stData.DataSize = uiDataLen-24;
		memcpy(stData.pData,&CGWCertificate2,stData.DataSize);
			break;
#endif
	case eCOMM_CARB_OPEN:
		uiProtocolID = ISO15765_CARB;
		VCI_SetPassThruProtocolID((unsigned char*)&uiProtocolID);
		uiDataLen = 10 + 24;	//24 : stPASSTHRU_MSG 의 앞부분
		stData.DataSize = uiDataLen-24;
		memcpy(stData.pData,&CARBOpencode,stData.DataSize);
		break;
	case eCOMM_Get_AutoVIN:
		if(ucPACVType == CV)
		{
			uiProtocolID = ISO15765_29BIT;
			VCI_SetPassThruProtocolID((unsigned char*)&uiProtocolID);

			uiDataLen = 10 + 24;	//24 : stPASSTHRU_MSG 의 앞부분
			stData.DataSize = uiDataLen-24;

			g_uiAutoVinReqPacketIdx = g_uiAutoVinReqPacketIdx%eAUTOVIN_CV_REQ_MAX;
	        g_eCVAutoVinReqFuelType = (eCV_AUTOVIN_STATE)g_uiAutoVinReqPacketIdx;
//          printf("~~~~g_uiAutoVinReqPacketIdx : %d g_eCVAutoVinReqFuelType : %d \r\n",g_uiAutoVinReqPacketIdx,g_eCVAutoVinReqFuelType);
	    	memcpy(stData.pData, CVVINcode[g_uiAutoVinReqPacketIdx++], stData.DataSize);
        }
		else // if(ucPACVType == PA)
		{
			uiProtocolID = ISO15765_CARB;
			VCI_SetPassThruProtocolID((unsigned char*)&uiProtocolID);
			uiDataLen = 10 + 24;	//24 : stPASSTHRU_MSG 의 앞부분
			stData.DataSize = uiDataLen-24;


			// 전기차 내연차 수소차 구분 필요
			if ( g_bAutoVinNegativeResponse == FALSE )
			{
	    		g_uiAutoVinReqPacketIdx = g_uiAutoVinReqPacketIdx%eAUTOVIN_REQ_MAX;
	            g_eAutoVinReqFuelType = (eAUTOVIN_STATE)g_uiAutoVinReqPacketIdx;
	//            printf("~~~~g_uiAutoVinReqPacketIdx : %d g_eAutoVinReqFuelType : %d \r\n",g_uiAutoVinReqPacketIdx,g_eAutoVinReqFuelType);
	    		memcpy(stData.pData, VINcode[g_uiAutoVinReqPacketIdx++], stData.DataSize);
			}
	        else
	        {
	            // 부정응답 수신시
				memcpy(VINcode, VINcodeNegative, 10);
				g_bAutoVinNegativeResponse = FALSE;
				g_uiAutoVinReqPacketIdx = 0;
	            g_eAutoVinReqFuelType = (eAUTOVIN_STATE)g_uiAutoVinReqPacketIdx;
	        }
		}
		break;
	case eOBD_GetFuelLevelCheck:
		for( i =0; i<g_usCurrentCnt ; i++)
		{
			if(strncmp(g_pstCurrDataBase[i].m_cIndexFine, DCS_FUEL_LEVEL, DCS_CURRENT_INDEX_SIZE)==0 ||
			strncmp(g_pstCurrDataBase[i].m_cIndexFine, DCS_HYDROGEN_CUR_STOR, DCS_CURRENT_INDEX_SIZE)==0)
			{
				for( j=0; j<(sizeof(g_pstCurrDataBase[i].m_cReqNode)/2); j++ )
				{
					stData.pData[j] = AsciiToHex(g_pstCurrDataBase[i].m_cReqNode[j*2], g_pstCurrDataBase[i].m_cReqNode[j*2+1]);
				}
			}
		}
		if( FuelLevelCheckCode[1] == 0xDF )	uiProtocolID = ISO15765_CARB;
		else													uiProtocolID = ISO15765;
		VCI_SetPassThruProtocolID((unsigned char*)&uiProtocolID);
		uiDataLen = sizeof(g_pstCurrDataBase[i].m_cReqNode)/2 + 24;	//24 : stPASSTHRU_MSG 의 앞부분
		stData.DataSize = uiDataLen-24;
		break;
	case eOBD_GetSOH:
		for( i =0; i<g_usCurrentCnt ; i++)
		{
			if(strncmp(g_pstCurrDataBase[i].m_cIndexFine, DCS_SOH_STATE, DCS_CURRENT_INDEX_SIZE)==0)
			{
				for( j=0; j<(sizeof(g_pstCurrDataBase[i].m_cReqNode)/2); j++ )
				{
					stData.pData[j] = AsciiToHex(g_pstCurrDataBase[i].m_cReqNode[j*2], g_pstCurrDataBase[i].m_cReqNode[j*2+1]);
				}
			}
		}
		if( FuelLevelCheckCode[1] == 0xDF )	uiProtocolID = ISO15765_CARB;
		else													uiProtocolID = ISO15765;
		VCI_SetPassThruProtocolID((unsigned char*)&uiProtocolID);
		uiDataLen = sizeof(g_pstCurrDataBase[i].m_cReqNode)/2 + 24;	//24 : stPASSTHRU_MSG 의 앞부분
		stData.DataSize = uiDataLen-24;
		break;
	case eOBD_GetBrakeJudder:
		for( i =0; i<g_usCurrentCnt ; i++)
		{
			if(strncmp(g_pstCurrDataBase[i].m_cIndexFine, DCS_BRAKEJUDDER_VALUE, DCS_CURRENT_INDEX_SIZE)==0)
			{
				for( j=0; j<(sizeof(g_pstCurrDataBase[i].m_cReqNode)/2); j++ )
				{
					stData.pData[j] = AsciiToHex(g_pstCurrDataBase[i].m_cReqNode[j*2], g_pstCurrDataBase[i].m_cReqNode[j*2+1]);
				}
			}
		}
		uiProtocolID = ISO15765;
		VCI_SetPassThruProtocolID((unsigned char*)&uiProtocolID);
		uiDataLen = sizeof(g_pstCurrDataBase[i].m_cReqNode)/2 + 24;	//24 : stPASSTHRU_MSG 의 앞부분
		stData.DataSize = uiDataLen-24;
		break;
	case eCOMM_DTC_FUNCTION:
		uiDataLen=10+24;
		stData.DataSize = uiDataLen-24;
		memcpy(stData.pData, &g_pDTCRequest[ParaCounter*10], stData.DataSize);
		if(ParaCounter%3 == 1)	//DTC READ
		{
			g_stDTCFuncData[(ParaCounter-1)/3].m_ucState=0;	//FAIL
			g_stDTCFuncData[(ParaCounter-1)/3].m_nOdometer = Get_Odmeter();	//FCS ODOMETER
			g_pDTCState[(ParaCounter-1)/3] = TRUE;
			OemGetRTCTime(ucNowTime);
			memcpy(g_stDTCFuncData[(ParaCounter-1)/3].m_ucFCSTime, &ucNowTime[1], DCS_DATE_INDEX_SIZE);
/*
            printf("==================================================\r\n");
            printf("dtc y:%d,m:%d,d:%d, h:%d,m:%d,s:%d\r\n",
                ucNowTime[1],ucNowTime[2],ucNowTime[3],
                ucNowTime[4],ucNowTime[5],ucNowTime[6]);
*/
		}
		break;
//	case eCOMM_SUPP_FUNCTION:
//		if(ODO_SUPP_GET_STATE() == ODO_SUPP_FALSE || ODO_SUPP_GET_STATE() == ODO_SUPP_COMPLETE || ODO_SUPP_GET_STATE() == ODO_SUPP_NONE || ODO_SUPP_GET_STATE() == ODO_SUPP_HI)
//		{
//			return false;
//		}
//		uiDataLen=10+24;
//		stData.DataSize = uiDataLen-24;
//		memcpy(stData.pData, &g_pSuppRequest[ParaCounter*10], stData.DataSize);
//		break;
	case eCOMM_FAST_FUNCTION:
		uiDataLen=10+24;
		stData.DataSize = uiDataLen-24;

		strncpy((char *)str, (char *)&g_pFastRequest[ParaCounter*10], 10);
		size =  strlen((char *)str);

		if( (size < ucVehicleCANCheckSize) || (g_bFuelLiterTypeFlag == true) || (g_stBrakeJudder.bValid == true) )
			return false;
		memcpy(stData.pData, &g_pFastRequest[ParaCounter*10], stData.DataSize);
		break;
	case eCOMM_SLOW1_FUNCTION:
		uiDataLen=10+24;
		stData.DataSize = uiDataLen-24;

		strncpy((char *)str, (char *)&g_pSlow1Request[ParaCounter*10], 10);
		size =  strlen((char *)str);
		if( (size<ucVehicleCANCheckSize)  || (g_bFuelLiterTypeFlag == true) || (g_stBrakeJudder.bValid == true) )
			return false;
		memcpy(stData.pData, &g_pSlow1Request[ParaCounter*10], stData.DataSize);
		break;
	case eCOMM_SLOW2_FUNCTION:
		uiDataLen=10+24;
		stData.DataSize = uiDataLen-24;

		strncpy((char *)str, (char *)&g_pSlow2Request[ParaCounter*10], 10);
		size =  strlen(str);
		if( (size<ucVehicleCANCheckSize)  || (g_bFuelLiterTypeFlag == true) || (g_stBrakeJudder.bValid == true) )
			return false;
		memcpy(stData.pData, &g_pSlow2Request[ParaCounter*10], stData.DataSize);
		break;

	case eCOMM_SLOW3_FUNCTION:
		uiDataLen=10+24;
		stData.DataSize = uiDataLen-24;

		strncpy((char *)str, (char *)&g_pSlow3Request[ParaCounter*10], 10);
		size =  strlen(str);
		if( (size<ucVehicleCANCheckSize)  || (g_bFuelLiterTypeFlag == true) || (g_stBrakeJudder.bValid == true) )
			return false;
		memcpy(stData.pData, &g_pSlow3Request[ParaCounter*10], stData.DataSize);
		break;

	default:
		GITDebugPrintf("[%s] default!!!!! %d\r\n", __FUNCTION__,FunctionType);
		return 0;
		break;
	}

	if( (stData.pData[1]==0xDF)&&(stData.pData[3]==0x01) || FunctionType == eCOMM_CARB_OPEN)
	{
		uiProtocolID=ISO15765_CARB;
  		VCI_SetPassThruProtocolID((unsigned char*)&uiProtocolID);
	}
	else if(ucPACVType == CV)
    {
        uiProtocolID=ISO15765_29BIT;
  		VCI_SetPassThruProtocolID((unsigned char*)&uiProtocolID);
    }
    else
	{
		uiProtocolID=ISO15765;
  		VCI_SetPassThruProtocolID((unsigned char*)&uiProtocolID);
	}

	VCI_ProtocolClassification((unsigned char*)&stData, uiDataLen);

	return true;
}

bool VCI_ProtocolClassification(unsigned char *pData, unsigned int uiDataLen)
{
	unsigned long uiProtocolID;

	uiProtocolID = VCI_GetPassThruProtocolID();

		if( (uiProtocolID == ISO15765)       ||
			(uiProtocolID == ISO15765_CARB)  ||
//		(uiProtocolID == ISO15765_NEW) 							||
//		(uiProtocolID == ISO14229_UDS) 							||
//		(uiProtocolID == ISO14229) 									||
//		(uiProtocolID == ISO15765_CUBIS)							||
//		(uiProtocolID == ISO15765_SINGLE)						||
//		(uiProtocolID == ISO15765_SINGLE_SMK)				||
//		(uiProtocolID == ISO15765_SINGLE_PODS)				||
//		(uiProtocolID == ISO15765_CARB) 						||
//		(uiProtocolID == ISO15765_REPRO_PENNIMG) 		||
//		(uiProtocolID == ISO15765_REPRO_PENNIMG_TIME)||
//		(uiProtocolID == ISO15765_NORMAL)						||
//		(uiProtocolID == ISO15765_CAN_HWSET_DB)			||
//		(uiProtocolID == ISO15765_CAN_HWSET_DB_SINGLE)||
//		(uiProtocolID == ISO15765_EXCEPT) 					||
		(uiProtocolID == ISO15765_29BIT )) 						
//		(uiProtocolID == ISO15765_29BIT_EXCEPT)			||
//		(uiProtocolID == ISO15765_CARB_29BIT ) )
	{
		CAN_SavePassThruWriteMsg(pData, uiDataLen);
	}
	else
	{
		GITDebugPrintf("[%s] not support Protocol ID 0x%X \r\n", __FUNCTION__, uiProtocolID);
		return 0;	//config에 프로토콜이 can이 아닌경우 다음 시험으로 넘어가야 한다
	}

	return true;
}
void VCI_SendtoECUCommManager(void)
{
	CAN_TxBlockProc();
}



/*****************************END OF FILE****/


